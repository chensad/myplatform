## apps/public/app_demo/package/buildroot/Config.in
```kconfig
config BR2_PACKAGE_APP_DEMO
    bool "app_demo"
    help
      Minimal demo application for the platform skeleton.
```

## platform/boards/imx6ull_100ask_pro/buildroot/external/Config.in
```kconfig
menu "imx6ull_100ask_pro external options"

source "$BR2_EXTERNAL_IMX6ULL_100ASK_PRO_PATH/../../../../../apps/public/app_demo/package/buildroot/Config.in"

endmenu
```
